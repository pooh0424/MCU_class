//
// LCD_Bmp : display Logo Bitmap on LCD
//
// Bitmap Creation:
// Step 1. use Paint to draw 128x64 bitmap 
// Step 2. use bmp2asm to convert bitmap into hex
// Step 3. cut hex code paste into char array Bitmap[128*8]
// Step 4. build & download code to learning board, then bitmap will be displayed on LCD
//
#include <stdio.h>
#include "NUC100Series.h"
#include "MCU_init.h"
#include "SYS_init.h"
#include "LCD.h"
#include "Scankey.h"


unsigned char BMP_Logo_Nuvoton[128*8] = { // Nuvoton Logo 
	0x00,0x00,0x00,0x00,0x00,0x00,0x00,0x00,0x00,0x00,0x00,0x00,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0x00,
	0x00,0x00,0x00,0x00,0x00,0x00,0x80,0xC0,0xE0,0xE0,0xE0,0x60,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0x00,
	0x00,0x00,0x00,0x00,0x00,0x00,0x7F,0x7F,0x7F,0x7F,0x00,0x00,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0x00,
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	0x00,0x00,0x00,0x00,0x00,0x00,0x00,0x00,0x00,0x00,0x00,0x00,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0x00
};


volatile int direction = 0;


void GPAB_IRQHandler(void)
{
    if (PA->ISRC & BIT0) {        // check if PB12 interrupt occurred
        PA->ISRC |= BIT0;			// clear PB12 interrupt status
				if(direction==0){
						direction = 2;
				}

    } else if (PA->ISRC & BIT1) { // check if Pb13 interrupt occurred
        PA->ISRC |= BIT1;         // clear PB13 interrupt status  
				direction = 0;
    } else if (PA->ISRC & BIT2) { // check if PB14 interrupt occurred
        PA->ISRC |= BIT2;         // clear PB14 interrupt status  
				if(direction==0){
						direction = 1;
				}			
    } else {                      // else it is unexpected interrupts
        PA->ISRC = PA->ISRC;	      // clear all GPB pins
    }
}

void Init_KEY(void)
{
		GPIO_SetMode(PA, BIT3, GPIO_MODE_OUTPUT);
		GPIO_SetMode(PA, BIT4, GPIO_MODE_OUTPUT);
		GPIO_SetMode(PA, BIT5, GPIO_MODE_OUTPUT);
    GPIO_SetMode(PA, (BIT0 | BIT1| BIT2), GPIO_MODE_QUASI);
		PA3=1; PA4=0; PA5=1;
    GPIO_EnableInt(PA, 0, GPIO_INT_FALLING);
    GPIO_EnableInt(PA, 1, GPIO_INT_FALLING);
    GPIO_EnableInt(PA, 2, GPIO_INT_FALLING);		
    NVIC_EnableIRQ(GPAB_IRQn);   
    GPIO_SET_DEBOUNCE_TIME(GPIO_DBCLKSRC_LIRC, GPIO_DBCLKSEL_64);
    GPIO_ENABLE_DEBOUNCE(PA, (BIT0 | BIT1| BIT2));	
}

void move_img() {
	if(direction==1){//left
		for(int i=0;i<8;i++){
			int buffer=BMP_Logo_Nuvoton[i*128];
			for(int j=0;j<128;j++){
				if(j==127){
					BMP_Logo_Nuvoton[i*128+j]=buffer;
				}else{
					BMP_Logo_Nuvoton[i*128+j]=BMP_Logo_Nuvoton[i*128+j+1];
				}
			}
		}
	}
	else if (direction==2){//right
		for(int i=0;i<8;i++){
			int buffer=BMP_Logo_Nuvoton[i*128+127];
			for(int j=127;j>=0;j--){
				if(j==0){
					BMP_Logo_Nuvoton[i*128]=buffer;
				}else{
					BMP_Logo_Nuvoton[i*128+j]=BMP_Logo_Nuvoton[i*128+j-1];
				}
			}
		}
	}
}

int main(void)
{
	uint32_t count = 0;
	SYS_Init();
	init_LCD();
	clear_LCD();
	draw_LCD(BMP_Logo_Nuvoton);
	Init_KEY();
	while(1) {
		if(direction!=0){
			if(count==200){
				count=0;
				if(direction==1){
					move_img();
				}
				else if(direction==2){
					move_img();
				}
				draw_LCD(BMP_Logo_Nuvoton);
			}
			else{
				count++;
			}
		}
	  CLK_SysTickDelay(200);		
	}
}

