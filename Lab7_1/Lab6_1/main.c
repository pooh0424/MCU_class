//
// LCD_Bmp : display Logo Bitmap on LCD
//
// Bitmap Creation:
// Step 1. use Paint to draw 128x64 bitmap 
// Step 2. use bmp2asm to convert bitmap into hex
// Step 3. cut hex code paste into char array Bitmap[128*8]
// Step 4. build & download code to learning board, then bitmap will be displayed on LCD
//
#include <stdio.h>
#include "NUC100Series.h"
#include "MCU_init.h"
#include "SYS_init.h"
#include "LCD.h"
#include "Scankey.h"


unsigned char BMP_Logo_Nuvoton[128*8] = { // Nuvoton Logo 
	0x00,0x00,0x00,0x00,0x00,0x00,0x00,0x00,0x00,0x00,0x00,0x00,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0x00,
	0x00,0x00,0x00,0x00,0x00,0x00,0x80,0xC0,0xE0,0xE0,0xE0,0x60,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0x00,
	0x00,0x00,0x00,0x00,0x00,0x00,0x7F,0x7F,0x7F,0x7F,0x00,0x00,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0x00,
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	0x00,0x00,0x00,0x00,0x00,0x00,0x00,0x00,0x00,0x00,0x00,0x00,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0x00
};

void move_img(unsigned char *img,int direction) {
	if(direction==1){//left
		for(int i=0;i<8;i++){
			int buffer=img[i*128];
			for(int j=0;j<128;j++){
				if(j==127){
					img[i*128+j]=buffer;
				}else{
					img[i*128+j]=img[i*128+j+1];
				}
			}
		}
	}
	else if (direction==2){//right
		for(int i=0;i<8;i++){
			int buffer=img[i*128+127];
			for(int j=127;j>=0;j--){
				if(j==0){
					img[i*128]=buffer;
				}else{
					img[i*128+j]=img[i*128+j-1];
				}
			}
		}
	}
	else if (direction==3){//up
		unsigned char out[128];
		for(int j=0;j<128;j++){
			out[j]=(img[j]%2<<7);
		}
		for(int i=0;i<7;i++){
			for(int j=0;j<128;j++){
				img[i*128+j]=((img[i*128+j]/2))+(img[(i+1)*128+j]%2<<7);
			}
		}
		for(int j=0;j<128;j++){
			img[7*128+j]=((img[7*128+j]/2))+out[j];
		}
	}
	else if (direction==4){//down
		unsigned char out[128];
		for(int j=0;j<128;j++){
			out[j]=(img[7*128+j]/128);
		}
		for(int i=7;i>0;i--){
			for(int j=0;j<128;j++){
				img[i*128+j]=((img[i*128+j]%128)<<1)+(img[(i-1)*128+j]/128);
			}
		}
		for(int j=0;j<128;j++){
			img[j]=((img[j]%128)<<1)+out[j];
		}
	}
}

int main(void)
{
	uint32_t i =0;
	uint32_t last_i = 0;
	uint32_t state = 0;
	uint32_t count = 0;
	SYS_Init();
	OpenKeyPad();  
	init_LCD();
	clear_LCD();
	draw_LCD(BMP_Logo_Nuvoton);
	
	while(1) {
		if(state!=0){
			if(count==200){
				count=0;
				if(state==1){
					move_img(BMP_Logo_Nuvoton,1);
				}
				else if(state==2){
					move_img(BMP_Logo_Nuvoton,2);
				}
				else if(state==3){
					move_img(BMP_Logo_Nuvoton,3);
				}
				else if(state==4){
					move_img(BMP_Logo_Nuvoton,4);
				}
				draw_LCD(BMP_Logo_Nuvoton);
			}
			else{
				count++;
			}
		}
		i=ScanKey();
		if(i!=0){
			last_i=i;
			continue;
		}
		if(last_i == 2 && state==0){
			state = 3;
		}
		else if(last_i == 4&& state==0){
			state = 1;
		}	
		else if(last_i==6&&state==0){
			state = 2;
		}
		else if(last_i==8&&state==0){
			state = 4;
		}
		else if(last_i==5&&state!=0){
			state = 0;
			count = 0;
		}

	  CLK_SysTickDelay(200);		
	}
}

